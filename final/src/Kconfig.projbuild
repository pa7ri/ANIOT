## final/src/Kconfig.projbuild
```kconfig
menu "Configuration for sensors"
    config SAMPLE_FREQ
        int "Time frequency between readings"
        default 10000
        help
        Set the time frequency in millis among sensor readings

    config N_SAMPLES
        int "Number of samples per reading"
        default 5
        help
        Set the number of samples taken per reading
endmenu
menu "Quality Air Sensor"
    config I2C_MASTER_SDA
        int "SDA GPIO Num"
        default 21 
        help
            GPIO number for I2C Master data line.

    config I2C_MASTER_SCL
        int "SCL GPIO Num"
        default 22 
        help
            GPIO number for I2C Master clock line.
endmenu
```

## p2/src/Kconfig.projbuild
```kconfig
menu "Configuracion propia"
    config PRINT_MALLOC_INFO
        bool "Print malloc output"
        default yes
        help
        print malloc info
    config FREE_APP_MEMOYRY
        bool "Free memory after malloc"
        default yes
        help
        call free after malloc every iteration
endmenu
```

## p3-cont/src/Kconfig.projbuild
```kconfig
menu "Configuracion propia"
    config PRINT_MALLOC_INFO
        bool "Print malloc output"
        default yes
        help
        print malloc info

    config FREE_APP_MEMOYRY
        bool "Free memory after malloc"
        default yes
        help
        call free after malloc every iteration

    config IS_INFRARED_ACTIVE
        bool "Active infrared sensor"
        default yes
        help
        Set 'true' to use infrarred as chronometer reset, set 'false' to use sensor hall instead 
endmenu
```

## p4/entregable/Kconfig.projbuild
```kconfig
menu "Temperature sensor config"
    config MILLIS_TO_PRINT
        int "Print temperature sensor value each X millis"
        default 4000
        help
            Insert millis for periodic print of temperature, default value: 4000, aka, 4 seconds.

    config I2C_MASTER_SDA
        int "SDA GPIO Num"
        default 21 
        help
            GPIO number for I2C Master data line.

    config I2C_MASTER_SCL
        int "SCL GPIO Num"
        default 22 
        help
            GPIO number for I2C Master clock line.
    
    config SI7021_I2C_SLAVE_ADDRESS
        hex "SI7021 I2C Slave Address - 7 bits is 1000000 - 0x40"
        default 0x40
        help
            Hardware Address of I2C Slave Port.
endmenu
```

## p4/src/Kconfig.projbuild
```kconfig
menu "Temperature sensor config"
    config MILLIS_TO_PRINT
        int "Print temperature sensor value each X millis"
        default 4000
        help
            Insert millis for periodic print of temperature, default value: 4000, aka, 4 seconds.

    config I2C_MASTER_SDA
        int "SDA GPIO Num"
        default 21 
        help
            GPIO number for I2C Master data line.

    config I2C_MASTER_SCL
        int "SCL GPIO Num"
        default 22 
        help
            GPIO number for I2C Master clock line.
    
    config I2C_SLAVE_ADDRESS
        hex "ESP Slave Address"
        default 0x28
        help
            Hardware Address of I2C Slave Port.

    config SENSOR_SLAVE_ADDRESS
        hex "Sensor Slave Address - 7 bits is 1000000 - 0x40"
        default 0x40 
        help
            Hardware Address of I2C Slave Port.
endmenu
```

## p5/src/Kconfig.projbuild
```kconfig
menu "Temperature sensor config"
    config MILLIS_TO_PRINT
        int "Print temperature sensor value each X millis"
        default 4000
        help
            Insert millis for periodic print of temperature, default value: 4000, aka, 4 seconds.

    config I2C_MASTER_SDA
        int "SDA GPIO Num"
        default 21 
        help
            GPIO number for I2C Master data line.

    config I2C_MASTER_SCL
        int "SCL GPIO Num"
        default 22 
        help
            GPIO number for I2C Master clock line.
    
    config SI7021_I2C_SLAVE_ADDRESS
        hex "SI7021 I2C Slave Address - 7 bits is 1000000 - 0x40"
        default 0x40
        help
            Hardware Address of I2C Slave Port.
    
    config ENABLE_READ_TASK_IMPLEMENTATION
        bool "Enable read temerature sensor from task "
        default yes
        help
            Enable implement task for read temperature sensor and disable timer implementation.

    config LIGHT_SLEEP_MODE_ACTIVE
        bool "Enable light sleep mode"
        default yes
        help
            Enable light sleep mode and disable deep sleep mode 

    config DEEP_SLEEP_MODE_ACTIVE
        bool "Enable deep sleep mode"
        default no
        help
            Enable deep sleep mode, this is allow only if light sleep mode is disabled
endmenu
```
